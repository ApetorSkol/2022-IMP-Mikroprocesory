/* IMP Demo Application for ESP32
   (c) Michal Bidlo, Brno University of Technology, FIT, 2021, bidlom@fit.vut.cz

   This example code is in the Public Domain (or CC0 licensed, at your option.)

   Unless required by applicable law or agreed to in writing, this
   software is distributed on an "AS IS" BASIS, WITHOUT WARRANTIES
   OR CONDITIONS OF ANY KIND, either express or implied.
*/

/**
 * Brief:
 * This test code shows how to configure gpio and how to use gpio interrupt.
 * Application of ledc_timer is also demonstrated for generating a tone
 * frequency that can be played by externally connected speaker.
 *
 * GPIO status:
 * GPIO18: output
 * GPIO19: output
 * GPIO4:  input, pulled-up, interrupt from both rising and falling edge
 * GPIO5:  input, pulled-up, interrupt from rising edge only
 *
 * Test:
 * Connect GPIO18 with GPIO4
 * Connect GPIO19 with GPIO5
 * Generate pulses on GPIO18/19, that triggers interrupt on GPIO4/5
 *
 */

#include <stdio.h>
#include <string.h>
#include <stdlib.h>
#include "freertos/FreeRTOS.h"
#include "freertos/task.h"
#include "freertos/queue.h"
#include "driver/gpio.h"
#include "driver/ledc.h"
#include "esp_err.h"

// Connect the speaker to GPIO14 and GND.
#define SPK_GPIO_NUM 14
// internal LED of the board is on GPIO2
#define LED_PORT_OUT 2

// The frequency for the speaker will be generated by LEDC_TIMER_0,
// here is its configuration (see also the function ledc_timer_init()).
#define LEDC_TIMER_NUM  LEDC_TIMER_0
#define LEDC_TIMER_MODE LEDC_LOW_SPEED_MODE
#define LEDC_CHANNEL    LEDC_CHANNEL_0
#define LEDC_DUTY_RES   LEDC_TIMER_4_BIT // duty resolution 4 bits
#define LEDC_DUTY       15 // Set duty to 50%. ((2 ** 4) - 1) * 50% = 15
#define LEDC_FREQUENCY  1000 // Frequency in Hertz for the speaker

// Connect GPIOs 18 with 4 and 19 with 5 by wires. 18, 19 are output GPIOs
// and these will generate edges for the input GPIOs 4 and 5. The input GPIOs
// will request Interrupr Service Rutine (ISR) to be called every time when
// a given edge (0->1 or 1->0 or both) are detected (see also the GPIO setup
// in gpio_initialize()).
#define GPIO_OUT1    18
#define GPIO_OUT2    19
#define OUTPUT_PIN_MASK ((1ULL<<LED_PORT_OUT) | (1ULL<<GPIO_OUT1) | (1ULL<<GPIO_OUT2))
#define GPIO_IN1     4
#define GPIO_IN2     5
#define INPUT_PIN_MASK ((1ULL<<GPIO_IN1) | (1ULL<<GPIO_IN2))
#define ESP_INTR_FLAG_DEFAULT 0

static xQueueHandle event_queue = NULL;

static void IRAM_ATTR gpio_isr_handler(void* arg)
{
    uint32_t gpio_num = (uint32_t) arg;
    xQueueSendFromISR(event_queue, &gpio_num, NULL);
}

static void gpio_task_example(void* arg)
{
    uint32_t io_num;
    while (1)
    {
        if(xQueueReceive(event_queue, &io_num, portMAX_DELAY)) {
            printf("GPIO[%d] intr, val: %d\n", io_num, gpio_get_level(io_num));
        }
    }
}

static void gpio_initialize(void)
{
    // configuration structure for output GPIO 18 and 19
    gpio_config_t gpio_cfg = {
        .pin_bit_mask = OUTPUT_PIN_MASK, // set as output mode...
        .mode = GPIO_MODE_OUTPUT,            // ...using an appropriate bit mask, here for GPIO 18 and 19
        .pull_up_en = 0,                     // disable pull-down mode
        .pull_down_en = 0,                   // disable pull-up mode
        .intr_type = GPIO_INTR_DISABLE       // configure GPIO with the given settings
    };
    gpio_config(&gpio_cfg);  // set the configuration

    // prepare configuration for the input pins 4 and 5
    gpio_cfg.intr_type = GPIO_INTR_POSEDGE;  // interrupt of rising edge
    gpio_cfg.pin_bit_mask = INPUT_PIN_MASK;  // bit mask for  GPIOs 4 and 5
    gpio_cfg.mode = GPIO_MODE_INPUT;         // set GPIOs 4 and 5 as inputs
    gpio_cfg.pull_up_en = 1;                 // enable pull-up mode
    gpio_config(&gpio_cfg);

    // change gpio intrrupt type for one pin
    gpio_set_intr_type(GPIO_IN1, GPIO_INTR_ANYEDGE);

    event_queue = xQueueCreate(10, sizeof(uint32_t)); // create a queue to handle gpio event from isr
    xTaskCreate(gpio_task_example, "gpio_task_example", 2048, NULL, 10, NULL);  // start gpio task

    gpio_install_isr_service(ESP_INTR_FLAG_DEFAULT); // install gpio interrupt service routine...
    gpio_isr_handler_add(GPIO_IN1, gpio_isr_handler, (void*) GPIO_IN1); //...to be called from IN1 (GPIO4)
    gpio_isr_handler_add(GPIO_IN2, gpio_isr_handler, (void*) GPIO_IN2); // and also from IN2 (GPIO5)
}

static void ledc_timer_init(void)
{
    // Prepare and then apply the LEDC PWM timer configuration
    ledc_timer_config_t ledc_timer = {
        .speed_mode       = LEDC_TIMER_MODE,
        .timer_num        = LEDC_TIMER_NUM,
        .duty_resolution  = LEDC_DUTY_RES,
        .freq_hz          = LEDC_FREQUENCY,
        .clk_cfg          = LEDC_AUTO_CLK
    };
    ESP_ERROR_CHECK(ledc_timer_config(&ledc_timer));

    // Prepare and then apply the LEDC PWM channel configuration
    ledc_channel_config_t ledc_channel = {
        .speed_mode     = LEDC_TIMER_MODE,
        .channel        = LEDC_CHANNEL,
        .timer_sel      = LEDC_TIMER_NUM,
        .intr_type      = LEDC_INTR_DISABLE,
        .gpio_num       = SPK_GPIO_NUM,
        .duty           = 0, // Set duty to 0%
        .hpoint         = 0
    };
    ESP_ERROR_CHECK(ledc_channel_config(&ledc_channel));

    // Set the PWM duty to 50% according to the parameters defined above
    // (here we want to generate ordinary square wave for driving the speaker)
    ESP_ERROR_CHECK(ledc_set_duty(LEDC_TIMER_MODE, LEDC_CHANNEL, LEDC_DUTY));
}

void app_main(void)
{
    gpio_initialize();
    ledc_timer_init();

    int cnt = 0;
    int beep = 1; // whetger the ledc timer should run or be paused
    while(1) {
        printf("cnt = %d\n", cnt++);
        vTaskDelay(500 / portTICK_RATE_MS);
        gpio_set_level(GPIO_OUT1, cnt % 4);
        gpio_set_level(GPIO_OUT2, cnt % 4);
        // switch the LED light and speaker beeping
        if (beep)
        {
            gpio_set_level(LED_PORT_OUT, 0);
            ledc_timer_pause(LEDC_TIMER_MODE, LEDC_TIMER_NUM);
            beep = false;
        }
        else
        {
            gpio_set_level(LED_PORT_OUT, 1);
            ledc_timer_resume(LEDC_TIMER_MODE, LEDC_TIMER_NUM);
            beep = true;
        }
    }
}
